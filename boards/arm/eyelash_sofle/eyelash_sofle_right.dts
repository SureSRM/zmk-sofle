/*
*
* Copyright (c) 2021 Darryl deHaan
* SPDX-License-Identifier: MIT
*
*/
#include "eyelash_sofle.dtsi"

&kscan0 {
     col-gpios
        = <&gpio0 22 GPIO_ACTIVE_HIGH>
         , <&gpio0 29 GPIO_ACTIVE_HIGH>
         , <&gpio0 3 GPIO_ACTIVE_HIGH>
         , <&gpio0 28 GPIO_ACTIVE_HIGH>
         , <&gpio0 30 GPIO_ACTIVE_HIGH>
         , <&gpio0 21 GPIO_ACTIVE_HIGH>
         , <&gpio0 23 GPIO_ACTIVE_HIGH>
         ;
};

&default_transform {
    col-offset = <7>;
};

&i2c1 {
    status = "okay";

    oled_right: ssd1306_right@3d {
        compatible = "solomon,ssd1306fb";
        reg = <0x3D>;
        label = "OLED_RIGHT";
        height = <32>;
        width = <128>;
        segment-offset = <0>;
        page-offset = <0>;
        display-offset = <0>;
        multiplex-ratio = <31>;
    };
};